## Documentation/devicetree/bindings/arm/hisilicon/hisilicon-bvt.yaml
```yaml
# SPDX-License-Identifier: (GPL-2.0-only OR BSD-2-Clause)
%YAML 1.2
---
$id: http://devicetree.org/schemas/arm/hisilicon/hisilicon-bvt.yaml#
$schema: http://devicetree.org/meta-schemas/core.yaml#

title: HiSilicon BVT IP Camera SoC Platforms

maintainers:
  - Dmitry Ilyin <6576495+widgetii@users.noreply.github.com>

description: |
  HiSilicon BVT (Broadcast Video Technology) SoC family — ARM Cortex-A7
  processors used in IP cameras and video surveillance equipment.

properties:
  $nodename:
    const: /
  compatible:
    oneOf:
      - items:
          - const: hisilicon,hi3516ev200
      - items:
          - const: hisilicon,hi3516ev300
      - items:
          - const: hisilicon,hi3518ev200
      - items:
          - const: hisilicon,hi3518ev300
      - items:
          - const: hisilicon,hi3516dv200
      - items:
          - const: hisilicon,hi3516dv300

additionalProperties: true
```

## Documentation/devicetree/bindings/clock/hisilicon,hi3516ev200-clock.yaml
```yaml
# SPDX-License-Identifier: (GPL-2.0-only OR BSD-2-Clause)
%YAML 1.2
---
$id: http://devicetree.org/schemas/clock/hisilicon,hi3516ev200-clock.yaml#
$schema: http://devicetree.org/meta-schemas/core.yaml#

title: HiSilicon BVT SoC Clock/Reset Generator (CRG)

maintainers:
  - Dmitry Ilyin <6576495+widgetii@users.noreply.github.com>

description: |
  The CRG (Clock/Reset Generator) provides clock and reset control for
  all peripherals on HiSilicon BVT IP camera SoCs.

properties:
  compatible:
    enum:
      - hisilicon,hi3516ev200-clock
      - hisilicon,hi3516ev300-clock
      - hisilicon,hi3518ev200-clock
      - hisilicon,hi3518ev300-clock
      - hisilicon,hi3516dv200-clock
      - hisilicon,hi3516dv300-clock

  reg:
    maxItems: 1

  '#clock-cells':
    const: 1

  '#reset-cells':
    const: 2

required:
  - compatible
  - reg
  - '#clock-cells'
  - '#reset-cells'

additionalProperties: false

examples:
  - |
    clock@12010000 {
        compatible = "hisilicon,hi3516ev300-clock";
        reg = <0x12010000 0x1000>;
        #clock-cells = <1>;
        #reset-cells = <2>;
    };
```

## Documentation/devicetree/bindings/i2c/hisilicon,hibvt-i2c.yaml
```yaml
# SPDX-License-Identifier: (GPL-2.0-only OR BSD-2-Clause)
%YAML 1.2
---
$id: http://devicetree.org/schemas/i2c/hisilicon,hibvt-i2c.yaml#
$schema: http://devicetree.org/meta-schemas/core.yaml#

title: HiSilicon BVT I2C Controller

maintainers:
  - Dmitry Ilyin <6576495+widgetii@users.noreply.github.com>

allOf:
  - $ref: /schemas/i2c/i2c-controller.yaml#

properties:
  compatible:
    oneOf:
      - items:
          - enum:
              - hisilicon,hi3516ev200-i2c
              - hisilicon,hi3516ev300-i2c
              - hisilicon,hi3518ev300-i2c
              - hisilicon,hi3516dv200-i2c
              - hisilicon,hi3516dv300-i2c
          - const: hisilicon,hibvt-i2c

  reg:
    maxItems: 1

  clocks:
    maxItems: 1

  clock-frequency:
    default: 100000

  interrupts:
    maxItems: 1

required:
  - compatible
  - reg
  - clocks

unevaluatedProperties: false

examples:
  - |
    #include <dt-bindings/clock/hi3516ev300-clock.h>
    i2c@12060000 {
        compatible = "hisilicon,hi3516ev300-i2c", "hisilicon,hibvt-i2c";
        reg = <0x12060000 0x1000>;
        clocks = <&clock 45>;
        clock-frequency = <100000>;
        #address-cells = <1>;
        #size-cells = <0>;
    };
```
